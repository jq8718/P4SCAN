## components/ov01c1b/Kconfig
```kconfig
menuconfig CAMERA_OV01C1B
    bool "OV01C1B"
    default y
    depends on SOC_MIPI_CSI_SUPPORTED
    help
        Enable support for the OV01C1B CMOS image sensor.

if CAMERA_OV01C1B
    config CAMERA_OV01C1B_AUTO_DETECT_MIPI_INTERFACE_SENSOR
        bool "Detect OV01C1B on MIPI CSI interface"
        default y

    config CAMERA_OV01C1B_MIPI_RAW10_1024X1024_50FPS
        bool "MIPI 1-lane, 24M input, 1024x1024 50fps, RAW10"
        default y

    choice CAMERA_OV01C1B_MIPI_DEFAULT_FMT
        prompt "Select default output format for MIPI CSI interface"
        default CAMERA_OV01C1B_MIPI_DEFAULT_FMT_RAW10_1024X1024_50FPS

        config CAMERA_OV01C1B_MIPI_DEFAULT_FMT_RAW10_1024X1024_50FPS
            bool "MIPI 1-lane, 24M input, 1024x1024 50fps, RAW10"
            depends on CAMERA_OV01C1B_MIPI_RAW10_1024X1024_50FPS
    endchoice

    config CAMERA_OV01C1B_MIPI_IF_FORMAT_INDEX_DEFAULT
        int
        default 0 if CAMERA_OV01C1B_MIPI_DEFAULT_FMT_RAW10_1024X1024_50FPS

    config CAMERA_OV01C1B_MIPI_CLK_MHZ
        int "MIPI lane bit rate in MHz"
        range 100 1500
        default 1300
        help
            Bring-up default comes from the vendor register file comment
            "phy_clk=1434M". Adjust this after oscilloscope measurement.

    config CAMERA_OV01C1B_KEEP_STREAM_ON
        bool "Keep OV01C1B stream enabled when CSI stops"
        default n
        help
            Keep the sensor transmitting MIPI after the CSI video device is
            stopped. This is only for probing the MIPI clock during bring-up;
            it prevents a later CSI reopen from restarting the sensor cleanly.

    config CAMERA_OV01C1B_TEST_PATTERN
        bool "Enable OV01C1B internal test pattern"
        default n
        help
            Enable the sensor's internal test pattern registers for MIPI/CSI
            bring-up. The test pattern is monochrome and is not camera output.

    config CAMERA_OV01C1B_COLORBAR_FULL_1032X1032
        bool "Use 1032x1032 CSI dimensions for ColorBar"
        depends on CAMERA_OV01C1B_TEST_PATTERN
        default n
        help
            OV01C1B ColorBar output uses the sensor's full 1032x1032 pattern
            size. Enable this only when the internal ColorBar is enabled.

    choice CAMERA_OV01C1B_BAYER_PATTERN
        prompt "Bayer pattern"
        default CAMERA_OV01C1B_BAYER_BGGR
        help
            Temporary bring-up default. Confirm with raw frame analysis later.

        config CAMERA_OV01C1B_BAYER_RGGB
            bool "RGGB"
        config CAMERA_OV01C1B_BAYER_GRBG
            bool "GRBG"
        config CAMERA_OV01C1B_BAYER_GBRG
            bool "GBRG"
        config CAMERA_OV01C1B_BAYER_BGGR
            bool "BGGR"
    endchoice
endif
```

## components/p4scan_board_power/Kconfig
```kconfig
menu "P4SCAN Board Power"

    config P4SCAN_OV01C1B_POWER_ENABLE
        bool "Power OV01C1B through PCA9538A"
        default y
        help
            Initialize PCA9538A on the shared I2C bus and run the OV01C1B
            power-up sequence before esp_video probes the camera sensor.

    config P4SCAN_PCA9538A_I2C_ADDR
        hex "PCA9538A I2C address"
        default 0x70
        depends on P4SCAN_OV01C1B_POWER_ENABLE

endmenu
```

## main/Kconfig.projbuild
```kconfig
menu "Example Configuration"

    config P4SCAN_UVC_TEST_PATTERN
        bool "Stream generated RGB565 test pattern instead of camera"
        default n
        help
            Generate a 1920x1080 RGB565 test pattern and send it through the
            same hardware JPEG encoder and UVC path. This is useful to isolate
            UVC/JPEG transport issues from camera/ISP capture issues.

    config P4SCAN_CSI_RAW10_BYPASS_ISP
        bool "Request CSI RAW10 output and bypass ISP"
        default n
        help
            Request the sensor RAW10 format directly from the CSI device.
            This is intended for sensor and CSI bring-up diagnostics.

    if FORMAT_MJPEG_CAM1
        config EXAMPLE_JPEG_COMPRESSION_QUALITY
            int "JPEG compression quality (%)"
            default 80
            range 1 100
    endif

    if FORMAT_H264_CAM1
        config EXAMPLE_H264_I_PERIOD
            int "H.264 Intra Frame period (frames)"
            default 120
            range 1 120

        config EXAMPLE_H264_BITRATE
            int "H.264 Target bitrate (bps)"
            default 1000000
            range 25000 2500000

        config EXAMPLE_H264_MIN_QP
            int "H.264 Minimum quantization parameter (QP)"
            default 25
            range 1 51

        config EXAMPLE_H264_MAX_QP
            int "H.264 Maximum quantization parameter (QP)"
            default 26
            range 1 51
    endif
endmenu
```

## sdkconfig.defaults
```kconfig
# ESP32-P4 Function EV Board defaults
# Flash: 16MB GD25Q128ES1G, mode DIO, 80MHz
CONFIG_IDF_TARGET="esp32p4"
CONFIG_ESPTOOLPY_FLASHSIZE_16MB=y
CONFIG_ESPTOOLPY_FLASHMODE_DIO=y
CONFIG_ESPTOOLPY_FLASHFREQ_80M=y

# PSRAM: 4MB octal, use external memory for large allocations
CONFIG_SPIRAM=y
CONFIG_SPIRAM_MODE_HEX=y
CONFIG_SPIRAM_USE_MALLOC=y
CONFIG_SPIRAM_MALLOC_ALWAYSINTERNAL=16384
CONFIG_SPIRAM_ALLOW_STACK_EXTERNAL_MEMORY=y
CONFIG_SPIRAM_SPEED_20M=y
# CONFIG_SPIRAM_SPEED_200M is not set

# ESP32-P4 Function EV Board + OV01C1B over MIPI-CSI
CONFIG_EXAMPLE_SELECT_ESP32P4_FUNCTION_EV_BOARD_V1_5=y
CONFIG_EXAMPLE_ENABLE_MIPI_CSI_CAM_SENSOR=y
CONFIG_EXAMPLE_SCCB_I2C_INIT_BY_APP=y
CONFIG_EXAMPLE_SCCB_I2C_PORT_INIT_BY_APP=0
CONFIG_EXAMPLE_MIPI_CSI_SCCB_I2C_FREQ=100000
CONFIG_CAMERA_OV01C1B=y
CONFIG_CAMERA_OV01C1B_AUTO_DETECT_MIPI_INTERFACE_SENSOR=y
CONFIG_CAMERA_OV01C1B_MIPI_RAW10_1024X1024_50FPS=y
CONFIG_CAMERA_OV01C1B_MIPI_DEFAULT_FMT_RAW10_1024X1024_50FPS=y
CONFIG_CAMERA_OV01C1B_MIPI_CLK_MHZ=1434
# CONFIG_CAMERA_OV01C1B_KEEP_STREAM_ON is not set
CONFIG_CAMERA_OV01C1B_BAYER_BGGR=y
# CONFIG_CAMERA_SC2336 is not set

# Video pipeline: OV01C1B RAW -> ISP RGB565 -> hardware JPEG -> USB Video Class
CONFIG_ESP_VIDEO_ENABLE_MIPI_CSI_VIDEO_DEVICE=y
CONFIG_ESP_VIDEO_ENABLE_HW_H264_VIDEO_DEVICE=y
CONFIG_ESP_VIDEO_ENABLE_HW_JPEG_ENC_VIDEO_DEVICE=y
CONFIG_FORMAT_MJPEG_CAM1=y
# CONFIG_FORMAT_H264_CAM1 is not set
CONFIG_UVC_MODE_BULK_CAM1=y
# CONFIG_UVC_MODE_ISOC_CAM1 is not set
# CONFIG_FRAMESIZE_VGA is not set
CONFIG_FRAMESIZE_SVGA=y
# CONFIG_FRAMESIZE_HD is not set
# CONFIG_FRAMESIZE_FHD is not set
CONFIG_UVC_CAM1_FRAMERATE=2
CONFIG_UVC_CAM1_FRAMESIZE_WIDTH=1024
CONFIG_UVC_CAM1_FRAMESIZE_HEIGT=1024
# CONFIG_UVC_CAM1_MULTI_FRAMESIZE is not set
CONFIG_EXAMPLE_JPEG_COMPRESSION_QUALITY=30
# CONFIG_P4SCAN_UVC_TEST_PATTERN is not set
CONFIG_EXAMPLE_H264_BITRATE=1000000
CONFIG_EXAMPLE_H264_I_PERIOD=120
CONFIG_EXAMPLE_H264_MIN_QP=25
CONFIG_EXAMPLE_H264_MAX_QP=26

# Required by esp_video on ESP32-P4.
CONFIG_IDF_EXPERIMENTAL_FEATURES=y
CONFIG_EXAMPLE_DISABLE_USB_MSC_STORAGE=y
```
